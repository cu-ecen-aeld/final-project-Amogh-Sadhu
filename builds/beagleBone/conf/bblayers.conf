## builds/beagleBone/conf/bblayers.conf
```bitbake
# POKY_BBLAYERS_CONF_VERSION is increased each time build/conf/bblayers.conf
# changes incompatibly
POKY_BBLAYERS_CONF_VERSION = "2"

BBPATH = "${TOPDIR}"
BBFILES ?= ""

BBLAYERS ?= " \
  /home/amogh/yocto-project/poky/meta \
  /home/amogh/yocto-project/poky/meta-poky \
  /home/amogh/yocto-project/poky/meta-yocto-bsp \
  "
```
